/**
 * @cliArgs --board "/ti/boards/CC1352R1_LAUNCHXL" --rtos "tirtos" --product "simplelink_cc13xx_cc26xx_sdk@5.30.00.56"
 * @versions {"tool":"1.10.0+2163"}
 */

/**
 * Import the modules used in this configuration.
 */
const Display  = scripting.addModule("/ti/display/Display", {}, false);
const Display1 = Display.addInstance();
const ADC      = scripting.addModule("/ti/drivers/ADC", {}, false);
const ADC1     = ADC.addInstance();
const GPIO     = scripting.addModule("/ti/drivers/GPIO", {}, false);
const GPIO1    = GPIO.addInstance();
const PWM      = scripting.addModule("/ti/drivers/PWM", {}, false);
const PWM1     = PWM.addInstance();
const Power    = scripting.addModule("/ti/drivers/Power");

/**
 * Write custom configuration values to the imported modules.
 */
Display1.$name                    = "CONFIG_Display_0";
Display1.useUART2                 = false;
Display1.uart.$name               = "CONFIG_UART_0";
Display1.uart.txPinInstance.$name = "CONFIG_GPIO_0";
Display1.uart.rxPinInstance.$name = "CONFIG_GPIO_1";

ADC1.$name = "CONFIG_ADC_0";

GPIO1.$hardware          = system.deviceData.board.components.LED_RED;
GPIO1.initialOutputState = "High";
GPIO1.$name              = "Board_GPIO_LED0";

PWM1.$name             = "CONFIG_PWM_0";
PWM1.$hardware         = system.deviceData.board.components.LED_GREEN;
PWM1.timerObject.$name = "CONFIG_GPTIMER_0";

const CCFG              = scripting.addModule("/ti/devices/CCFG", {}, false);
CCFG.ccfgTemplate.$name = "ti_devices_CCFGTemplate0";

/**
 * Pinmux solution for unlocked pins/peripherals. This ensures that minor changes to the automatic solver in a future
 * version of the tool will not impact the pinmux you originally saw.  These lines can be completely deleted in order to
 * re-solve from scratch.
 */
Display1.uart.uart.$suggestSolution            = "UART0";
Display1.uart.uart.txPin.$suggestSolution      = "boosterpack.32";
Display1.uart.uart.rxPin.$suggestSolution      = "boosterpack.18";
ADC1.adc.$suggestSolution                      = "ADC0";
ADC1.adc.adcPin.$suggestSolution               = "boosterpack.2";
GPIO1.gpioPin.$suggestSolution                 = "boosterpack.39";
PWM1.timerObject.timer.$suggestSolution        = "GPTM0";
PWM1.timerObject.timer.pwmPin.$suggestSolution = "boosterpack.40";
